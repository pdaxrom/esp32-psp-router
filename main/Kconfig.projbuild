## main/Kconfig.projbuild
```kconfig
menu "PSP USB router"
    choice PSP_NETWORK_MODE
        prompt "Network architecture"
        default PSP_MODE_ROUTER
        config PSP_MODE_ROUTER
            bool "USB WAN + Wi-Fi LAN, IPv4 NAPT and browser gateway"
        config PSP_MODE_BRIDGE
            bool "USB/Wi-Fi bridge (optional browser gateway)"
    endchoice

    config PSP_HTTP_PROXY
        bool "PSP HTTP to HTTPS browser gateway"
        default y if PSP_MODE_ROUTER
        default n
        help
            In bridge mode, also answers the exact DNS name psp-proxy for Wi-Fi
            clients using the current bridge DHCP address. Other DNS and DHCP
            traffic stays on the computer's network. No NAT or local DHCP server.

    config PSP_BRIDGE_PROXY
        bool
        default y if PSP_MODE_BRIDGE && PSP_HTTP_PROXY

    config PSP_PROXY_PORT
        int "Browser proxy TCP port"
        depends on PSP_HTTP_PROXY
        range 1024 65535
        default 8080

    choice PSP_USB_PROFILE
        prompt "USB host operating system"
        default PSP_USB_RNDIS
        config PSP_USB_RNDIS
            bool "Windows 10/11: RNDIS"
        config PSP_USB_ECM
            bool "macOS / Linux: CDC-ECM"
    endchoice

    choice PSP_AP_SECURITY
        prompt "Wi-Fi security (never changes automatically)"
        default PSP_AP_WPA2
        config PSP_AP_WPA2
            bool "WPA2-PSK / AES-CCMP (ARK-5 WPA2 Support enabled)"
        config PSP_AP_WPA1
            bool "WPA-PSK / TKIP (PSP compatible)"
        config PSP_AP_OPEN
            bool "OPEN diagnostic network (explicit opt-in)"
    endchoice

    config PSP_AP_PASSWORD
        string "Wi-Fi passphrase (8..63 printable ASCII characters)"
        default "psp3000wifi"
        depends on PSP_AP_WPA1 || PSP_AP_WPA2
        help
            Invalid passwords stop startup; they never select an open AP.

endmenu
```

## sdkconfig.defaults
```kconfig
CONFIG_IDF_TARGET="esp32s3"
CONFIG_ESPTOOLPY_FLASHSIZE_4MB=y
CONFIG_ESPTOOLPY_FLASHMODE_QIO=y
CONFIG_ESPTOOLPY_FLASHFREQ_80M=y
CONFIG_PARTITION_TABLE_CUSTOM=y
CONFIG_PARTITION_TABLE_CUSTOM_FILENAME="partitions.csv"
CONFIG_SPIRAM=y
CONFIG_SPIRAM_MODE_QUAD=y
CONFIG_SPIRAM_TYPE_AUTO=y
CONFIG_SPIRAM_SPEED_40M=y
CONFIG_SPIRAM_IGNORE_NOTFOUND=y
CONFIG_SPIRAM_MEMTEST=y
CONFIG_SPIRAM_USE_MALLOC=y
CONFIG_SPIRAM_MALLOC_ALWAYSINTERNAL=4096
CONFIG_COMPILER_OPTIMIZATION_SIZE=y
CONFIG_ESP_DEFAULT_CPU_FREQ_MHZ_240=y
CONFIG_ESP_CONSOLE_NONE=y
CONFIG_ESP_CONSOLE_SECONDARY_NONE=y
CONFIG_LOG_DEFAULT_LEVEL_NONE=y
CONFIG_BOOTLOADER_LOG_LEVEL_NONE=y
CONFIG_ESP_SYSTEM_PANIC_SILENT_REBOOT=y
# CONFIG_TINYUSB_CDC_ENABLED is not set
CONFIG_TINYUSB_NET_MODE_ECM_RNDIS=y
CONFIG_LWIP_IPV4=y
# CONFIG_LWIP_IPV6 is not set
CONFIG_LWIP_IP_FORWARD=y
CONFIG_LWIP_IPV4_NAPT=y
CONFIG_LWIP_DHCPS=y
CONFIG_LWIP_DHCPS_STATIC_ENTRIES=y
CONFIG_LWIP_NUM_NETIF_CLIENT_DATA=1
CONFIG_LWIP_BRIDGEIF_MAX_PORTS=2
CONFIG_LWIP_L2_TO_L3_COPY=y
CONFIG_ESP_NETIF_SET_DNS_PER_DEFAULT_NETIF=y
CONFIG_ESP_NETIF_IP_LOST_TIMER_INTERVAL=1
CONFIG_LWIP_TCPIP_TASK_STACK_SIZE=4096
CONFIG_LWIP_MAX_SOCKETS=16
CONFIG_LWIP_SNTP_MAX_SERVERS=2
CONFIG_MBEDTLS_CERTIFICATE_BUNDLE=y
CONFIG_MBEDTLS_CERTIFICATE_BUNDLE_DEFAULT_FULL=y
CONFIG_MBEDTLS_CERTIFICATE_BUNDLE_CROSS_SIGNED_VERIFY=y
CONFIG_MBEDTLS_DEFAULT_MEM_ALLOC=y
CONFIG_MBEDTLS_HAVE_TIME_DATE=y
CONFIG_PSP_MODE_ROUTER=y
CONFIG_PSP_HTTP_PROXY=y
CONFIG_ESP_WIFI_SOFTAP_SUPPORT=y
# CONFIG_ESP_WIFI_ENABLE_WPA3_SAE is not set
# CONFIG_ESP_WIFI_ENABLE_WPA3_OWE_STA is not set
# CONFIG_ESP_WIFI_ENABLE_WPA3_OWE_SOFTAP is not set
# CONFIG_ESP_WIFI_WPA3_COMPATIBLE_SUPPORT is not set
CONFIG_PSP_USB_RNDIS=y
CONFIG_PSP_AP_WPA2=y
CONFIG_PSP_AP_PASSWORD="psp3000wifi"
```
